## meta-sophgo-capricorn/bak/conf/layer.conf
```bitbake
# We have a conf and classes directory, add to BBPATH
BBPATH .= ":${LAYERDIR}"

# We have recipes-* directories, add to BBFILES
BBFILES += "${LAYERDIR}/recipes-*/*/*.bb \
            ${LAYERDIR}/recipes-*/*/*.bbappend"

BBFILE_COLLECTIONS += "meta-sophgo-capricorn"
BBFILE_PATTERN_meta-sophgo-capricorn = "^${LAYERDIR}/"
BBFILE_PRIORITY_meta-sophgo-capricorn = "6"

LAYERDEPENDS_meta-sophgo-capricorn = "core"
LAYERSERIES_COMPAT_meta-sophgo-capricorn = "kirkstone langdale"
```
